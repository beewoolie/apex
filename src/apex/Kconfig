## src/mach-mx5/Kconfig
```kconfig
if ARCH_MX5

choice
	prompt "Freescale MX51x Implementations"
	default MACH_GENESI_EFIKA

config MACH_GENESI_EFIKA
	bool "Genesi Efika Smarttop"
	select ARCH_MX51
	select USES_NOR_CFI
	select USES_NOR_BOOTFLASH
	select INLINE_PLATFORM_INITIALIZATION

endchoice

menu "Platform Setup"

choice
	prompt "CPU/Peripheral Clock"
	default FREQ_800_133

config FREQ_800
	bool "CPU 800 MHz - AHB 133 MHz"
	help
	  This setting configures the CPU frequency to 800 MHz.

endchoice

config ATAG_PHYS
	hex "Physical address for ATAGs list"
	default "0x90000100"
	depends on ATAG
	help
	  This is the address where APEX will construct the ATAG list
	  before starting the Linux kernel.  This address should be
	  within the first 16KiB of physical RAM.  Don't change this
	  value unless you know what you are doing. 

config ARCH_NUMBER
	int
	default 2336 if MACH_GENESI_EFIKA

config APEX_VMA
	hex "APEX Runtime Address"
	default "0x90200000"

config DCD_OFFSET
	hex "Loader DCD Offset"
	default "0x400"
	help
	  The boot image used by the iMX51 has a header that must be
	  0x400 (1KiB) bytes offset from the beginning of the image.
	  This header is called a DCD.  This offset is the number of
	  bytes from the beginning of the image to the DCD.  It
	  probably doesn't need to be changed. 

config KERNEL_LMA
	hex "Kernel Load Address"
	default "0x90008000"

config USE_RAMDISK
	bool "Enable ramdisk options"
	default n
	help
	  This option doesn't enable the ramdisk, per se.  It enables
	  other configuration options that help setup a default
	  ramdisk.  The kernel command line and the APEX startup
	  commands may be overridden to perform the same steps.

	  There is a separate option in the Environment section that
	  controls whether or not APEX copies the ramdisk from flash
	  into RAM at startup.  That is where the ramdisk region is
	  defined.

config RAMDISK_LMA
	hex "Ramdisk load address"
	default "0x94000000"
	depends on USE_RAMDISK
	help
	  This option sets the physical load address for an initial
	  ramdisk (a.k.a initrd).

config RAMDISK_SIZE
	hex "Ramdisk compressed size"
	default "0x00300000"
	depends on USE_RAMDISK
	help
	  This option sets the size, in bytes, of the initial ramdisk
	  (a.k.a. initrd).  This is the size of the compressed initrd
	  image.

config SDRAM_BANK0
	bool "Enable SDRAM Bank 0"
	default y

config SDRAM_BANK1
	bool "Enable SDRAM Bank 1"
	depends on SDRAM_BANK0
	default n 

choice
	prompt "Console UART"
	default MX51_UART1

config MX51_UART1
	bool "MX51 internal UART1"

endchoice

config EXCEPTIONS
       bool "Enable exception vectors"
       depends on MMU
       default y
       help
         Intalls exception vector handlers.  This option is required
         for interrupts as well, though interrupts are not implemented
         for this platform.  Set this option to Y to receive reports
         on undefined instructions and data/instruction fetch aborts. 

config EXTENDED_CPUINFO
	bool "Extended CPU into"
	depends on n
	default n
	help
	  For most targets, CPU info is a simple report of the
	  ARM CPU registers available on most cores.  This option
	  enables a report on many other registers.

	  *** Currently unimplemented.

endmenu

menu "Platform Drivers"

endmenu

config MACH
	string
	default "mx5"

config ARCH_MX51
	bool
	select CPU_ARMV7
	select CPU_CORTEX_A8

endif
```

## src/net/Kconfig
```kconfig
menu "Ethernet Networking"

config ETHERNET
	bool "Ethernet Network Stack"
	select USES_PATHNAME_PARSER
	default n
	help
	  This options enabled the Ethernet network stack, protocols
	  and commands. 

config PROTO_ICMP_ECHO
	bool "ICMP Echo (Ping) Handler"
	depends ETHERNET
	default n
	help
	  This option enables an ICMP request handler.  With it, the
	  network stack will answer ICMP echo requests.  It is OK to
	  leave this option N as this feature is unnecessary for
	  proper operation of the network stack.

config CMD_PING
	bool "Ping Command"
	depends ETHERNET
	default n
	help
	  This option add the ping command for testing network
	  connectivity.

config CMD_ARP
	bool "ARP Command for Testing"
	depends ETHERNET
	default n
	help
	  This option adds an arp command for testing the ethernet
	  interface.

config CMD_RARP
	bool "RARP Autoconfiguration Command"
	depends ETHERNET
	default n
	help
	  This protocol may be used to configure the Ethernet
	  interface IP parameters.

config CMD_TFTP
	bool "TFTP File Transfer Command"
	depends ETHERNET
	default n
	help
	  This protocol transfers files over the network.

endmenu

config MAC_FILTER
	bool
```
