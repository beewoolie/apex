## src/apex/Kconfig
```kconfig
menu "Commands"

config ALLHELP
	bool "Include all online help"
	default y
	depends on SMALL=n
	help
	  Setting this option will include all help text for APEX commands.

config ALPHABETIZE_COMMANDS
       bool "Sort commands alphabetically in help"
       default y
       depends on SMALL=n
       help
         Setting this option will sort alphabetically the commands
         shown in the help listing.  This option makes it easier to
         browse the help text.  It forces the inclusion of sort
         function, so it is automatically disabled when the SMALL
         configuration option is set.
 
config DEL_IS_BS
	bool "Use DEL as alias for Backspace"
	depends on !SMALL
	default y
	help
	  Some folks use a terminal program that insists that the
	  Backspace key send a DEL character.  This option allows them
	  to maintain this assumption.  It is best to leave this
	  option 'N' and fix your terminal program. 

config ANSI_KEYS
	bool "Interpret ANSI key sequences"
	depends on !SMALL
	default y
	help
	  Enables interpretation of some ANSI key sequences.
	 
config COMMAND_HISTORY
	bool "Command History"
	depends on !SMALL
	default y
	help
	  This option enables command history recall.  Use ^P and ^N
	  or the up and down arrow keys, when ANSI_KEYS is enabled, to
	  scroll through the previously entered commands.

config COMMAND_EDITING
	bool "Command Editing"
	depends on !SMALL
	default y
	help
	  This option enables in-place command editing using Emacs key
	  bindings.  Arrow keys move among the characters of the
	  command, typing inserts, and delete keys delete in the
	  middle of the command string.  See the on-line help for a
	  description of the available key sequences.

config CMD_ALIAS
        bool "Define Alias Commands"
	default y
	help
	  Aliases are a lighter-weight form of environment-like variable.
	  Aliases are not saved to flash and nor are they limited to
	  pre-defined keys as environment variables are.

config CMD_CHECKSUM
	bool "Define Checksum Region Command"
	default y
	help
	  Computes a CCITT CRC32 checksum over a region.

config CMD_COPY
	bool "Define Copy Regions Command"
	default y
	help
	  Copies from one region to another.

config CMD_COMPARE
	bool "Define Compare Regions Command"
	default y

config CMD_DRVINFO
	bool "Define Driver Info Command"
	default y
	help
	  Informational command that reports the status of APEX
	  drivers and services.  This is a good command to omit when
	  trying to make APEX small.

config CMD_DUMP
	bool "Define Dump Region Command"
	default y
	help
	  Shows the contents of a region on the console.

config CMD_ENV
	bool "Define Environment Commands"
	default y

config CMD_ERASEENV
	bool "Define Erase Environment Command"
	depends on CMD_ENV=y && ENV_MUTABLE=y
	default n
	help
	  Experimental feature that allows safe, complete erasure of
	  the environment.

config CMD_SETENV
	bool "Define Set/unset Environment Variable Commands"
	depends on CMD_ENV=y && ENV_MUTABLE=y
	default y

config CMD_ERASE
	bool "Define Erase Region Command"
	default y

config CMD_FILL
	bool "Define Fill Region Command"
	default y

config CMD_GO
	bool "Define Go Command"
	default y
	help
	  Allows transfer of execution to any memory address.

config CMD_INFO
	bool "Define Info Command"
	default y
	help
	  Show information about a region descriptor.  Use this command
	  to list the contents of a filesystem directory.

config CMD_PAUSE
	bool "Define Pause Command"
	default n

config CMD_WAIT
	bool "Define Wait Command"
	default y

config CMD_XRECEIVE
	bool "Define Xmodem Receive Command"
	default y

config CMD_EMAC_LH79524
	bool "Define LH79524/5 Ethernet MAC Command" 
	depends on DRIVER_EMAC_LH79524
	default y
	help
	  Commands to configure the built-in MAC of the LH79524 and
	  LH79525.  

config CMD_EMAC_LH79524_DIAG
	bool "Define LH79524 Ethernet MAC Diagnostics"
	depends on CMD_EMAC_LH79524
	default n
	help
	  Enable this option to add diagnostic sub-commands to the
	  emac command.  It adds a lot of code to APEX, so leave it
	  out unless you are sure you need it.

config CMD_ETH_SMC91X
	bool "Define SMC91x diagnostic commands"
	depends on DRIVER_SMC91X
	default n

config CMD_ETH_DM9000
	bool "Define DM9000 diagnostic commands"
	depends on USES_DM9000
	default n

config CMD_MEMLIMIT
	bool "Define Memlimit Command"
	default n
	help
	  This command constrains amount of RAM available to Linux
	  kernel.  It is useful for testing how the kernel
	  responds to a limited memory resource.

config CMD_CLCDC_SPLASH
	bool "Define CLCDC Splash sub-command"
	depends on DRIVER_LH_CLCDC
	default y
	help
	  This sub-command draws an image into the LCD frame buffer.

config CMD_CLCDC_TEST
	bool "Define CLCDC test sub-commands"
	depends on DRIVER_LH_CLCDC
	default n
	help
	  These sub-commands help with testing the CLCDC controller.

config CMD_ARM920_TEST
	bool "Define ARM920 CPU test sub-commands"
	depends on CPU_ARM920T || CPU_ARM922T
	default n
	help
	  These sub-commands allow for changes to the CP15 test
	  registers.

endmenu
```

## src/arch-arm/Kconfig
```kconfig
#
# For a description of the syntax of this configuration file,
# see Documentation/kbuild/kconfig-language.txt.
#

mainmenu "APEX Boot Loader Configuration"

config ARM
	bool
	default y
	help
	  The ARM series is a line of low-power-consumption RISC chip designs
	  licensed by ARM ltd and targeted at embedded applications and
	  handhelds such as the Compaq IPAQ.  ARM-based PCs are no longer
	  manufactured, but  legacy ARM-based PC hardware remains popular in
	  Europe.  There is an ARM Linux project with a web page at
	  <http://www.arm.linux.org.uk/>.


config CPU_ARMV4
	bool

config CPU_ARMV5
	bool

config CPU_XSCALE
	bool

config CPU_ARM720T
	bool

config CPU_ARM920T
	bool

config CPU_ARM922T
	bool

config CPU_ARM925T
	bool

config CPU_ARM926T
	bool

choice
	prompt "ARM Platform"
	default ARCH_LH7952X

config ARCH_LH7952X
	bool "Sharp LH7952X"

config ARCH_LH7A40X
	bool "Sharp LH7A40X"

config ARCH_IXP42X
	bool "Intel IXP42X"

endchoice

config EXPERIMENTAL
	bool "Enable experimental features"
	default n
	help
	  This option grants configuration access to experimental
	  features.  It is best to leave this disabled.

config SMALL
	bool "Make APEX small"
	default n
	help
	  This option helps make APEX as small as possible.  It
	  removes unnecessary strings and selects smallest command and
	  driver implementations when available.  Selecting this
	  option may make APEX difficult for novice users to operate.
config THUMB
	bool "Use Thumb instructions"
	default n
	depends on SMALL=y && EXPERIMENTAL=y
	help
	  This option builds some portions of the loader with thumb
	  instructions, a 16 bit instruction format available in some
	  ARM cores.  This feature is intended to produce a smaller
	  executable for the sake of squeezing more features into a
	  smaller space.
	  
	  This feature is experimental and, frankly unlikely to
	  work.  It's best to leave it disabled unless you are
	  prepared for the worst.

menu "General Setup"

config CROSS_COMPILE
	string "Cross compiler prefix"
	default "/usr/arm-linux/gcc-3.4.1-glibc-2.3.3/bin/arm-linux-" if ARCH_LH7952X
	default "/usr/arm-linux/gcc-3.4.1-glibc-2.3.3/bin/arm-linux-" if ARCH_LH7A40X
	default "/usr/armv5b-softfloat-linux/gcc-3.4.2-glibc-2.3.3/bin/armv5b-softfloat-linux-" if ARCH_IXP42X
	help
	  This option defines a compiler prefix for the building APEX
	  with a cross compiler.  This prefix may also be set with the
	  environment variable CROSS_COMPILE.  The environment
	  variable will override this configuration option.

config CC_OPTIMIZE_FOR_SIZE
	bool "Set compiler optimization for smallest code size"
	default y
	help
	  This option sets the -Os compiler option.  Otherwise, the
	  optimization option is -O2.  

config DEBUG_LL
	bool "Low-level debug support"
	default n
	help
	  Setting this option enables extra debug code in the bool
	  loader startup.

config SPINNER
	bool "Spinner"
	default y
	depends on SMALL=n
	help
	  Implements a user feedback device for showing progress when
	  APEX is executing long tasks.  Usually, the feedback is
	  limited to a spinning bar on the console.  Target
	  implementations may include custom code, e.g. flashing LEDs

config ATAG
	bool "Build ATAG list for Linux kernel"
	default y
	help
	  It is strongly recommended that ATAG support be included
	  with the boot loader.  Linux kernel version 2.6 requires
	  it.  Including ATAG support will not preclude booting to
	  older kernels.

config DISABLE_MMU_AT_BOOT
	bool "Disable MMU when APEX starts"
	default y
	help
	  Generally, it isn't necessary to disable the MMU when APEX
	  starts.  It is off when the CPU resets.  However, when
	  bootstrapping from one boot loader into APEX, it is
	  sometimes necessary to disable the MMU because the previous
	  loader fails to do so.  It is generally safe to leave this
	  feature enabled.

config INTERRUPTS
	bool "Enable interrupt handlers"
	depends on EXPERIMENTAL 
	default n
	help
	  This feature is experimental and non-operational.  Leave it
	  disabled.

config SDRAMBOOT_REPORT
	bool "Report that APEX was executed directly from SDRAM"
	default y
	depends on !SMALL
	help
 	  This option enables a message in the service report that APEX
	  was executed from SDRAM and, therefore, could not initialize
	  SDRAM.  This is purely informational, but is very helpful to
	  users who are new to using APEX.

endmenu

source src/mach-lh7952x/Kconfig
source src/mach-lh7a40x/Kconfig
source src/mach-ixp42x/Kconfig

source src/apex/Kconfig

source src/drivers/Kconfig
source src/drivers-lh/Kconfig

source src/net/Kconfig

menu "Environment"

choice
	prompt "Bootflash"
	default NOR_BOOT

config NOR_BOOT
	depends on USES_NOR_BOOTFLASH
	bool "NOR Flash Boot"

config NAND_BOOT
	depends on USES_NAND_BOOTFLASH
	bool "NAND Flash Boot"
	select RELOCATE_NAND
	help
	  Selecting NAND as the bootflash select an APEX relocation
	  routine to one that copies from the NAND.

endchoice

config AUTOBOOT
	bool "Automatically boot operating system"
	default n

config AUTOBOOT_DELAY
	int "Autoboot delay"
	depends on AUTOBOOT
	default "50"
	help
	  Tenths of a second that APEX will pause before automatically
	  booting the operating system kernel.

config ENV_MUTABLE
	bool "Allow runtime changes to the environment"
	default y
	help
	  This option enables a runtime, user changeable environment.
	  The target configuration must define a region to hold the
	  environment data.  Without a changeable environment, only
	  the default values will be available.

config ENV_REGION
	string "Environment region"
	depends on ENV_MUTABLE
	default "nor:128k+64k" if MACH_LPD7A40X
	default "nor:128k+64k" if MACH_LPD79520
	default "nor:128k+64k" if MACH_LNODE80
	default "nor:128k+64k" if (MACH_LPD79524 && NOR_BOOT)
	default "nand:64k+32k" if (MACH_LPD79524 && NAND_BOOT)
	default "nor:128k+64k" if MACH_NSLU2
	default "nor:120k+8k"  if MACH_KEV79524
	help
	  This region stores the user configurable environment.   

config ENV_STARTUP_KERNEL_COPY
	bool "Copy Linux kernel to RAM at startup" 
	default y
	
config ENV_REGION_KERNEL
	string "Source region for kernel"
	depends on ENV_STARTUP_KERNEL_COPY
	default "nor:256k+1024k" if MACH_LNODE80
	default "nor:256k+1536k" if MACH_LPD7A40X || MACH_LPD7952X
	default "nor:0x60010+0xffff0" if MACH_NSLU2
	default "nor:128k+1536k" if MACH_KEV79524
	help
	  At startup, APEX copies this region to the kernel start address.

config ENV_STARTUP_RAMDISK_COPY
	bool "Copy ramdisk to RAM at startup" 
	default y if MACH_LNODE80
	default y if MACH_NSLU2
	depends on USE_RAMDISK
	
config ENV_REGION_RAMDISK
	string "Source region for ramdisk image"
	depends on ENV_STARTUP_RAMDISK_COPY
	default "nor:1280k+1536k" if MACH_LNODE80
	default "nor:0x160010+0x69fff0" if MACH_NSLU2
	help
	  At startup, APEX copies this region to memory for use as a
	  ramdisk.

config ENV_DEFAULT_CMDLINE_OVERRIDE
	bool "Override the target default kernel command line"
	default false
	help
	  Set this option so that you can override the target's
	  default command line.  This may be useful if the target
	  console is not available to the user.

config ENV_DEFAULT_CMDLINE
	string "Default kernel command line"
	depends on ENV_DEFAULT_CMDLINE_OVERRIDE
	help
	  Setting this option will override the default command line
	  for the target.  One of these is used when there is no user
	  defined command line in the environment.  You may want to
	  use this option to set a custom command line when there is
	  not easy access to the console.

endmenu

config USES_NOR_BOOTFLASH
	bool

config USES_NAND_BOOTFLASH
	bool

config RELOCATE_NAND
	bool

config BIGENDIAN
	bool
```

## src/drivers-lh/Kconfig
```kconfig
if DRIVERS_LH

menu "Sharp-LH Drivers"

config DRIVER_LH_ADC
	bool "ADC"
	depends on HAS_LH_ADC
	default n
	help
	  This driver includes commands to initialize and test the
	  ADC/touchscreen controller.

config DRIVER_LH_MMC
	bool "MMC"
	depends on HAS_LH_MMC
	default n
	help
	  This driver supports the MMC/SD
	  (MultiMediaCard/SecureDigital) controller.

config DRIVER_LH_CLCDC
	bool "Color LCD"
	depends on HAS_LH_CLCDC
	default n
	help
	  This driver initializes the CLCD controller.  It is
	  necessary if you want to show a splash screen. 

config LCD_BGR
	bool "Use BGR pel encoding"
	depends on DRIVER_LH_CLCDC
	default n
	help
	  The AMBA framebuffer device drives red from bits 0-4 in the
	  TFT color value, and blue from bits 10-14.  Setting this
	  option swaps these roles.  This may be important if the
	  kernel requires that blue be in the least significant bits
	  of each framebuffer pel.

choice
	prompt "LCD Panel"
	depends on DRIVER_LH_CLCDC
	default LCD_3_5_QVGA_20

config LCD_3_5_QVGA_20
	bool "LCD 3.5\" QVGA w/HRTFT IC"

config LCD_5_7_QVGA_10
	bool "LCD 5.7\" QVGA"

config LCD_6_4_VGA_10
	bool "LCD 6.4\" VGA"

config LCD_12_1_SVGA_10
	bool "LCD 12.1\" SVGA"
	
endchoice

endmenu

endif

config HAS_LH_ADC
	bool

config HAS_LH_MMC
	bool

config HAS_LH_CLCDC
	bool

config DRIVERS_LH
	bool
```

## src/drivers-mxc/Kconfig
```kconfig
if DRIVERS_MXC

menu "Motorola iMX Drivers"

config DRIVER_MXC_SERIAL
	bool "Serial UART"
	depends on HAS_MXC_SERIAL
	default n
	help
	  This driver supports the MXC standard UART.

endmenu

config DRIVERS_MXC
	bool

config HAS_MXC_SERIAL
       bool

endif
```
