## src/drivers/Kconfig
```kconfig
menu "Generic Drivers"

config DRIVER_FAT
	bool "FAT Filesystem"
	select USES_PATHNAME_PARSER
	default n
	help
	  This driver implements a FAT filesystem driver.

config DRIVER_FAT_BLOCKDEVICE
	string "Underlying driver region"
	depends on DRIVER_FAT
	default "cf"
	help
	  The filesystem driver is staticly links to an underlying
	  driver/region for access to the media.  Set that region
	  here.  A later update to the filesystem code will let the
	  user specify this region dynamically. 
	

config DRIVER_EXT2
	bool "EXT2 Filesystem"
	select USES_PATHNAME_PARSER
	default n
	help
	  This driver implements an Ext2 filesystem driver.

config DRIVER_EXT2_BLOCKDEVICE
	string "Underlying driver region"
	depends on DRIVER_EXT2
	default "cf"
	help
	  The filesystem driver is staticly links to an underlying
	  driver/region for access to the media.  Set that region
	  here.  A later update to the filesystem code will let the
	  user specify this region dynamically. 
	

config DRIVER_JFFS2
	bool "JFFS2 Filesystem"
	select USES_PATHNAME_PARSER
	default n
	help
	  This driver implements a JFFS2 filesystem driver.

config DRIVER_JFFS2_BLOCKDEVICE
	string "Underlying driver region"
	depends on DRIVER_JFFS2
	default ""
	help
	  The filesystem driver is staticly links to an underlying
	  driver/region for access to the media.  Set that region
	  here.  A later update to the filesystem code will let the
	  user specify this region dynamically. 


config DRIVER_NOR_CFI
	bool "CFI NOR Flash"
	depends on USES_NOR_CFI=y
	default y
	help
	  This driver implements a CFI compliant NOR flash driver
	  which works with most contemporary NOR flash chips. 

config DRIVER_NOR_CFI_NO_BUFFERED
	bool "Inhibit Buffered Writes"
	depends on DRIVER_NOR_CFI
	default n
	help
	  This option disables the buffered write code in the CFI NOR
	  flash driver.  APEX is built with only one CFI flash write
	  routine.  If the target has flash without a write buffer,
	  this option must be used to force the driver to include the
	  slower, unbuffered write code.

	  Leave this option set to 'N' unless your target is
	  experiencing problems using the buffered write routine.

config DRIVER_COMPACTFLASH
	bool "CompactFlash"
	depends on USES_COMPACTFLASH=y
	default n
	help
	  This driver implements a CompactFlash driver for the target
	  platform.

config DRIVER_SMC91X
	bool "SMC91X Integrated Ethernet"
	depends on USES_SMC91X
	select USE_ETHERNET
	default y
	help
	  This driver initializes and activates the SMSC SMC91x
	  Ethernet controller.

endmenu

config USES_NOR_CFI
	bool

config USES_COMPACTFLASH
	bool

config USES_PATHNAME_PARSER
	bool

config USES_SMC91X
	bool

config USES_DM9000
	bool
```

## src/mach-ixp42x/Kconfig
```kconfig
if ARCH_IXP42X

choice
	prompt "IXP42X Implementations"
	default MACH_NSLU2

config MACH_NSLU2
	bool "Linksys NSLU2"
	select ARCH_IXP420
	select USES_NOR_CFI
	select USES_NOR_BOOTFLASH

endchoice

menu "Platform Setup"

config ATAG_PHYS
	hex "Physical address for ATAGs list"
	default "0x00000100"
	depends on ATAG
	help
	  This is the address where APEX will construct the ATAG list
	  before starting the Linux kernel.  This address should be
	  within the first 16KiB of physical RAM.  Don't change this
	  value unless you know what you are doing. 

config ARCH_NUMBER
	int
	default 597 if MACH_NSLU2

config APEX_VMA
	hex "APEX runtime address"
	default "0x00200000"

config KERNEL_LMA
	hex "Kernel load address"
	default "0x00008000"

config SDRAM_BANK0
	bool "Enable SDRAM bank 0"
	default y

config SDRAM_BANK1
	bool "Enable SDRAM bank 1"
	depends on SDRAM_BANK0

config SDRAM_BANK_LENGTH
	hex "Size, in bytes, of each SDRAM bank"
	default 0x02000000

config NOR_BUSWIDTH
	int "Width of NOR flash bus"
	default "16"
	
config NOR_BANK0
	bool "Enable NOR flash bank 0"
	default y

config NOR_BANK0_START
	hex "Physical address of NOR flash bank 0"
	default "0x50000000"
	depends on NOR_BANK0

config NOR_BANK0_LENGTH
	hex "Size, in bytes, of NOR flash bank 0"
	default "0x00800000" if MACH_NSLU2
	depends on NOR_BANK0

config ENV_STARTUP
	string "Extra commands for startup"
	help
	  This string is added to the default startup command string.
	  This is generally not needed, but the facility is available
	  ust in case.

endmenu

config MACH
	string
	default "ixp42x"

config ARCH_IXP420
	bool

endif
```

## src/mach-lh7952x/Kconfig
```kconfig
if ARCH_LH7952X

choice
	prompt "LH7952X Implementations"
	default MACH_LPD79524

config MACH_LPD79520
	bool "Logic Product Development LPD79520"
	select ARCH_LH79520
	select MACH_LPD7952X
	select USES_NOR_CFI
	select USES_COMPACTFLASH
	select USES_NOR_BOOTFLASH
	select USES_SMC91X
	select DRIVERS_LH

config MACH_LPD79524
	bool "Logic Product Development LPD79524"
	select ARCH_LH79524
	select MACH_LPD7952X
	select USES_NOR_CFI
	select USES_COMPACTFLASH
	select USES_NOR_BOOTFLASH
	select USES_NAND_BOOTFLASH
	select DRIVERS_LH
	select HAS_LH_ADC

config MACH_KEV79524
	bool "Sharp KEV79524"
	select ARCH_LH79524
	select USES_NOR_CFI
	select USES_NOR_BOOTFLASH
	select USES_NAND_BOOTFLASH
	select DRIVERS_LH
	select HAS_LH_ADC

config MACH_KEV79525
	bool "Sharp KEV79525"
	select ARCH_LH79525
	select USES_NOR_CFI
	select USES_NOR_BOOTFLASH
	select USES_NAND_BOOTFLASH
	select DRIVERS_LH
	select HAS_LH_ADC

endchoice

menu "Platform Setup"

config ATAG_PHYS
	hex "Physical address for ATAGs list"
	default "0x20000100"
	depends on ATAG
	help
	  This is the address where APEX will construct the ATAG list
	  before starting the Linux kernel.  This address should be
	  within the first 16KiB of physical RAM.  Don't change this
	  value unless you know what you are doing. 

config ARCH_NUMBER
	int
	default 537 if MACH_LPD79520
	default 609 if MACH_LPD79524
	default 609 if MACH_KEV79524

config APEX_VMA
	hex "APEX runtime address"
	default "0x20200000"

config KERNEL_LMA
	hex "Kernel load address"
	default "0x20008000"

config SDRAM_BANK0
	bool "Enable SDRAM bank 0"
	default y

config SDRAM_BANK1
	bool "Enable SDRAM bank 1"
	depends on SDRAM_BANK0
	default y if MACH_KEV79524 

config NOR_BUSWIDTH
	int "Width of NOR flash bus"
	default "16"
	
config NOR_BANK0
	bool "Enable NOR flash bank 0"
	default y

config NOR_BANK0_START
	hex "Physical address of NOR flash bank 0"
	default "0x40000000" if ARCH_LH79520
	default "0x44000000" if ARCH_LH79524
	default "0x44000000" if ARCH_LH79525
	depends on NOR_BANK0

config NOR_BANK0_LENGTH
	hex "Size, in bytes, of NOR flash bank 0"
	default "0x00800000" if MACH_LPD7952X
	default "0x00400000" if MACH_KEV79524
	default "0x00400000" if MACH_KEV79525
	depends on NOR_BANK0

config NOR_BANK1
	bool "Enable NOR flash bank 1"
	depends on NOR_BANK0
	default n if MACH_LPD79520
	default y if MACH_LPD79524

config NOR_BANK1_START
	hex "Physical address of NOR flash bank 1"
	default "0x45000000"
	depends on NOR_BANK1

config NOR_BANK1_LENGTH
	hex "Size, in bytes, of NOR flash bank 1"
	default "0x00800000"
	depends on NOR_BANK1

config NAND_LPD
	bool "Enable LPD enhanced NAND flash access"
	depends on MACH_LPD79524
	default y if MACH_LPD79524
	help
	  This options enables a mode for accessing NAND flash that
	  makes it possible to read NAND flash, NOR flash, and
	  CompactFlash simultaneously.

config ENV_STARTUP
	string "Extra commands for startup"
	default "emac mac 00:08:ee:00:51:e1;" if MACH_KEV79524
	help
	  This string is added to the default startup command string.
	  This is generally not needed, but the facility is available
	  just in case.  One platforms, for example, sets the MAC
	  address of the Ethernet controller this way.

endmenu

menu "Platform Drivers"

config DRIVER_EMAC_LH79524
	bool "LH79524/5 EMAC"
	depends on ARCH_LH79524 || ARCH_LH79525
	select DRIVER_CPLD_SPI if MACH_LPD79524
	select USE_ETHERNET
	default y
	help
	  This driver initializes the built-in Ethernet MAC of the
	  Sharp lh79524/5. 

config CLCDC
	bool "Color LCD Test"
	depends on MACH_LPD79520 || MACH_LPD79524
	default n
	help
	  This driver initializes and tests the CLCD controller.

config CODEC
	bool "Audio Codec"
	depends on MACH_LPD79524
	default n
	help
	  This driver includes commands to initialize and test the
	  TI audio codec as well as the CPUs SSP module.  

	  You will not be able to use this code without first creating
	  PCM test data.  It's best to leave this option disabled.

config CODEC_LH79520
	bool "Audio Codec"
	depends on MACH_LPD79520
	default n
	help
	  This driver includes commands to initialize and test the
	  TI audio codec as well as the CPUs SSP module.

config DRIVER_CPLD_SPI
	bool "LPD7952x CPLD SPI devices"
	depends on MACH_LPD79520 || MACH_LPD79524
	default n
	help
	  This driver implemets EEPROM SPI driver for the LPD 7952x
	  Card Engines.

config ADS7843
	bool "ADS7843 touchscreen test"
	depends on MACH_LPD79520
	default n
	help
	  This options implements a test routing for the ADS7843
	  touchscreen controller. 

endmenu

config MACH
	string
	default "lh7952x"

config ARCH_LH79520
	bool
	select CPU_ARMV4
	select CPU_ARM720T

config ARCH_LH79524
	bool
	select CPU_ARMV4
	select CPU_ARM720T

config ARCH_LH79525
	bool
	select CPU_ARMV4
	select CPU_ARM720T

config MACH_LPD7952X
	bool

endif
```

## src/mach-lh7a40x/Kconfig
```kconfig
if ARCH_LH7A40X

choice
	prompt "LH7A40X Implementations"
	default MACH_LPD7A404

config MACH_LPD7A400
	bool "Logic Product Development LPD7A400"
	select ARCH_LH7A400
	select MACH_LPD7A40X
	select USES_NOR_CFI
	select USES_COMPACTFLASH
	select USES_NOR_BOOTFLASH
	select USES_SMC91X
	select DRIVERS_LH
	select HAS_LH_CLCDC

config MACH_LPD7A404
	bool "Logic Product Development LPD7A404"
	select ARCH_LH7A404
	select MACH_LPD7A40X
	select USES_NOR_CFI
	select USES_COMPACTFLASH
	select USES_NOR_BOOTFLASH
	select HAS_LH_ADC
	select USES_SMC91X
	select HAS_LH_CLCDC
	select DRIVERS_LH

config MACH_TROUNCER
	bool "Interalia TROUNCER"
	select ARCH_LH7A404
	select USES_NOR_CFI
	select USES_COMPACTFLASH
	select USES_NOR_BOOTFLASH
	select HAS_LH_ADC
	select HAS_LH_MMC
	select DRIVERS_LH

endchoice

menu "Platform Setup"

config ATAG_PHYS
	hex "Physical address for ATAGs list"
	default "0xc0000100"
	depends on ATAG
	help
	  This is the address where APEX will construct the ATAG list
	  before starting the Linux kernel.  This address should be
	  within the first 16KiB of physical RAM.  Don't change this
	  value unless you know what you are doing. 

config ARCH_NUMBER_FUNCTION
	string
	default "determine_arch_number"

config APEX_VMA
	hex "APEX Runtime Address"
	default "0xc0200000"

config KERNEL_LMA
	hex "Kernel Load Address"
	default "0xc0008000"

config SDRAM_BANK0
	bool "Enable SDRAM Bank 0"
	default y

config SDRAM_BANK1
	bool "Enable SDRAM Bank 1"
	depends on SDRAM_BANK0
	default n 

config SDRAM_CONTIGUOUS
	bool "Initialize SDRAM to be contiguous"
	depends on SDRAM_BANK0
	default n
	help
	  This option initializes the SDRAM controller to map each
	  SDRAM into a contiguous bank, SROMLL.  Normally, SDRAM is
	  sparse in the address space.  Linux does not need this
	  option, but Windows/CE does.  Do not set this option unless
	  you know what you are doing.

endmenu

menu "Platform Drivers"

config CODEC
	bool "Audio Codec"
	default n
	help
	  This driver includes commands to initialize and test the
	  AC97 link and associated codec.

	  You will not be able to use this code without first creating
	  PCM test data.  It's best to leave this option disabled.

endmenu

config MACH
	string
	default "lh7a40x"

config ARCH_LH7A400
	bool
	select CPU_ARMV4
	select CPU_ARM9
	select CPU_ARM920T

config ARCH_LH7A404
	bool
	select CPU_ARMV4
	select CPU_ARM9
	select CPU_ARM920T

config MACH_LPD7A40X
	bool

endif
```

## src/mach-mx3/Kconfig
```kconfig
if ARCH_MX3

choice
	prompt "Freescale MX3 Implementations"
	default MACH_MX31ADS

config MACH_MX31ADS
	bool "Freescale MX31 Development Board"
	select ARCH_MX31
	select USES_NOR_CFI
	select USES_COMPACTFLASH
	select USES_CS8900

endchoice

menu "Platform Setup"

config ATAG_PHYS
	hex "Physical address for ATAGs list"
	default "0x80000100"
	depends on ATAG
	help
	  This is the address where APEX will construct the ATAG list
	  before starting the Linux kernel.  This address should be
	  within the first 16KiB of physical RAM.  Don't change this
	  value unless you know what you are doing. 

config ARCH_NUMBER
	int
	default 447 if MACH_MX31ADS

config APEX_VMA
	hex "APEX Runtime Address"
	default "0x80200000"

config KERNEL_LMA
	hex "Kernel Load Address"
	default "0x80008000"

config USE_RAMDISK
	bool "Enable ramdisk options"
	default n
	help
	  This option doesn't enable the ramdisk, per se.  It enables
	  other configuration options that help setup a default
	  ramdisk.  The kernel command line and the APEX startup
	  commands may be overridden to perform the same steps.

	  There is a separate option in the Environment section that
	  controls whether or not APEX copies the ramdisk from flash
	  into RAM at startup.  That is where the ramdisk region is
	  defined.

config RAMDISK_LMA
	hex "Ramdisk load address"
	default "0x84000000"
	depends on USE_RAMDISK
	help
	  This option sets the physical load address for an initial
	  ramdisk (a.k.a initrd).

config RAMDISK_SIZE
	hex "Ramdisk compressed size"
	default "0x00300000"
	depends on USE_RAMDISK
	help
	  This option sets the size, in bytes, of the initial ramdisk
	  (a.k.a. initrd).  This is the size of the compressed initrd
	  image.

config SDRAM_BANK0
	bool "Enable SDRAM Bank 0"
	default y

config SDRAM_BANK1
	bool "Enable SDRAM Bank 1"
	depends on SDRAM_BANK0
	default n 

choice
	prompt "Console UART"
	default MX31_UART1

config MX31_UART1
	bool "MX31 internal UART1"

config MX31ADS_UARTA
	bool "MX31ADS external UARTA"
	depends on MACH_MX31ADS

endchoice



endmenu

menu "Platform Drivers"

endmenu

config MACH
	string
	default "mx3"

config ARCH_MX31
	bool
	select CPU_ARMV6
	select CPU_ARM11
	select CPU_ARM1136

endif
```
